AUTOSAR XML (schema 00048)
package /ARDesign/SystemDesign
  composition sw component type TopLevelComposition
    component itsLIT: type=LIT
    component itsTUR: type=TUR
    connect itsLIT.VbOUT_LIT_FLPosition_flg -> itsTUR.PositionActive
    connect itsTUR.PowerMode -> itsLIT.VeINP_CAN_PowerMode_sig
  system ZCUPrototypeSystem: category=SYSTEM_DESCRIPTION, system-version=1.0.0
    system mapping SystemMapping_BcmSystemImpl
      sw-impl-mappings:
        swc to impl mapping itsLIT_ImplMapping: component-implementation=SwcImpLIT, component=ZCUPrototypeComposition.itsLIT
        swc to impl mapping itsTUR_ImplMapping: component-implementation=SwcImpTUR, component=ZCUPrototypeComposition.itsTUR
      sw-mappings:
        swc to ecu mapping SwcToEcuMapping: component=[ZCUPrototypeComposition.itsLIT, ZCUPrototypeComposition.itsTUR], ecu-instance=FLZCU
    root-software-compositions:
      root sw composition prototype ZCUPrototypeComposition: software-composition=TopLevelComposition
