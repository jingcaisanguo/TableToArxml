AUTOSAR XML (schema 00048)
package /ARDesign/SystemDesign
  composition sw component type TopLevelComposition
    component itsAUXL: type=AUXL
    component itsHorn: type=Horn
    connect itsAUXL.HornTemplateService -> itsHorn.Horn_Templet1
    connect itsAUXL.HornTemplateSignal -> itsHorn.Horn_Templet2
  system ZCUPrototypeSystem: category=SYSTEM_DESCRIPTION, system-version=1.0.0
    system mapping SystemMapping_McSystemImpl
      sw-impl-mappings:
        swc to impl mapping itsAUXL_ImplMapping: component-implementation=SwcImpAUXL, component=ZCUPrototypeComposition.itsAUXL
        swc to impl mapping itsHorn_ImplMapping: component-implementation=SwcImpHorn, component=ZCUPrototypeComposition.itsHorn
      sw-mappings:
        swc to ecu mapping SwcToEcuMapping: component=[ZCUPrototypeComposition.itsAUXL, ZCUPrototypeComposition.itsHorn], ecu-instance=FLZCU
    root-software-compositions:
      root sw composition prototype ZCUPrototypeComposition: software-composition=TopLevelComposition
