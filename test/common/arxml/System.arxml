AUTOSAR XML (schema 4.0)
standard types defined: Boolean, uint8
package /BcmTest
  base type BooleanBase: category=FIXED_LENGTH, base-type-size=8, base-type-encoding=BOOLEAN, native-declaration=boolean
  sender receiver interface PowerModeInterface
    data PowerMode: type=uint8
  sender receiver interface PositionActiveInterface
    data PositionActive: type=Boolean
package /AUTOSAR_MemMap/SwAddrMethods
  5 x sw addr method:
    CODE
    CONST
    VAR_CLEARED
    VAR_INIT
    VAR_POWER_ON_CLEARED
package /ARDesign/SystemDesign
  composition sw component type TopLevelComposition
  system ZCUPrototypeSystem: category=SYSTEM_DESCRIPTION, system-version=1.0.0
    root-software-compositions:
      root sw composition prototype ZCUPrototypeComposition: software-composition=TopLevelComposition
package /ARDesign/TopologyDesign
  ecu instance FLZCU
