AUTOSAR XML (schema 00048)
package /ECUExtractZCUP/VehicleProject
  system SDB326300: category=ECU_EXTRACT, system-version=13.54.06;2026/08/12, System.Ver: 0
    system mapping SystemMapping_CemSystemImpl
      sw-impl-mappings:
        11 x swc to impl mapping:
          itsAS_ExteriorLightIf_ImplMapping: component-implementation=Impl_AS_ExteriorLightIf, component=TopLevelComposition.ZCUP5.itsAS_ExteriorLightIf
          itsAS_ExteriorLightIfCore1_ImplMapping: component-implementation=Impl_AS_ExteriorLightIfCore1, component=TopLevelComposition.ZCUP5.itsAS_ExteriorLightIfCore1
          itsAS_InteriorLightIf_ImplMapping: component-implementation=Impl_AS_InteriorLightIf, component=TopLevelComposition.ZCUP5.itsAS_InteriorLightIf
          itsCDD_LoBeam_ZCUP_Safe_ImplMapping: component-implementation=Impl_CDD_LoBeam_ZCUP_Safe, component=TopLevelComposition.ZCUP5.itsCDD_LoBeam_ZCUP_Safe
          itsCDD_OM_ZCUP_ImplMapping: component-implementation=Impl_CDD_OM_ZCUP, component=TopLevelComposition.ZCUP5.itsCDD_OM_ZCUP
          itsCDD_PosnLamp_ZCUP_Safe_ImplMapping: component-implementation=Impl_CDD_PosnLamp_ZCUP_Safe, component=TopLevelComposition.ZCUP5.itsCDD_PosnLamp_ZCUP_Safe
          itsCDD_RCM_Safe_ImplMapping: component-implementation=Impl_CDD_RCM_Safe, component=TopLevelComposition.ZCUP5.itsCDD_RCM_Safe
          itsCDD_TurnLight_ZCUP_safe_ImplMapping: component-implementation=Impl_CDD_TurnLight_ZCUP_safe, component=TopLevelComposition.ZCUP5.itsCDD_TurnLight_ZCUP_safe
          itsIoHwAb_SmartDiag_ImplMapping: component-implementation=impl_IoHwAb_SmartDiag, component=TopLevelComposition.ZCUP5.itsIoHwAb_SmartDiag
          itsSWC_DrvierInformation_ImplMapping: component-implementation=Impl_SWC_DrvierInformation, component=TopLevelComposition.ZCUP5.itsSWC_DrvierInformation
          itsSWC_PasSaf_ZCUP_ImplMapping: component-implementation=Impl_SWC_PasSaf_ZCUP, component=TopLevelComposition.ZCUP5.itsSWC_PasSaf_ZCUP
      sw-mappings:
        swc to ecu mapping SwcToEcuMapping: ecu-instance=ZCUP5
          component:
            TopLevelComposition.ZCUP5.itsAS_ExteriorLightIf
            TopLevelComposition.ZCUP5.itsAS_ExteriorLightIfCore1
            TopLevelComposition.ZCUP5.itsAS_InteriorLightIf
            TopLevelComposition.ZCUP5.itsCDD_LoBeam_ZCUP_Safe
            TopLevelComposition.ZCUP5.itsCDD_OM_ZCUP
            TopLevelComposition.ZCUP5.itsCDD_PosnLamp_ZCUP_Safe
            TopLevelComposition.ZCUP5.itsCDD_RCM_Safe
            TopLevelComposition.ZCUP5.itsCDD_TurnLight_ZCUP_safe
            TopLevelComposition.ZCUP5.itsIoHwAb_SmartDiag
            TopLevelComposition.ZCUP5.itsSWC_DrvierInformation
            TopLevelComposition.ZCUP5.itsSWC_PasSaf_ZCUP
    root-software-compositions:
      root sw composition prototype TopLevelComposition: software-composition=TopLevelComposition
package /SwComponentType
  composition sw component type ZCUP5
    11 x component:
      itsAS_ExteriorLightIf: type=AS_ExteriorLightIf
      itsAS_ExteriorLightIfCore1: type=AS_ExteriorLightIfCore1_ZCUP
      itsAS_InteriorLightIf: type=AS_InteriorLightIf
      itsCDD_LoBeam_ZCUP_Safe: type=CDD_LoBeam_ZCUP_Safe
      itsCDD_OM_ZCUP: type=CDD_OM_ZCUP
      itsCDD_PosnLamp_ZCUP_Safe: type=CDD_PosnLamp_ZCUP_Safe
      itsCDD_RCM_Safe: type=CDD_RCM_Safe
      itsCDD_TurnLight_ZCUP_safe: type=CDD_TurnLight_ZCUP_safe
      itsIoHwAb_SmartDiag: type=IoHwAb_SmartDiag
      itsSWC_DrvierInformation: type=SWC_DrvierInformation
      itsSWC_PasSaf_ZCUP: type=SWC_PasSaf_ZCUP
    connect itsAS_ExteriorLightIf.DOH_REAR_SWIPING_ENABLE_CrossCore -> itsAS_ExteriorLightIfCore1.DOH_REAR_SWIPING_ENABLE_CrossCore
    connect itsAS_ExteriorLightIf.ExtTle9166OutControl -> itsMirrorWrapper.ExtTle9166OutControl
    connect itsCDD_OM_ZCUP.OM_PWM_Fog_Light_Rear -> itsAS_ExteriorLightIf.OM_PWM_Fog_Light_Rear
    connect itsCDD_OM_ZCUP.OM_PWM_LicensePlate_Light -> itsAS_ExteriorLightIf.OM_PWM_LicensePlate_Light
    connect itsCDD_OM_ZCUP.OM_PWM_Reverse_Light -> itsAS_ExteriorLightIf.OM_PWM_Reverse_Light
    connect itsHWDiagSpider.PP_HWDiagSpider_IOFaultState_Channel1 -> itsAS_ExteriorLightIf.SwipingDirectionIndicatorEnabler_IOFaultState
    connect itsIoHwAb_AnalogIn.AI_RVMirrorTempSensor -> itsSWC_DrvierInformation.AI_RVMirrorTempSensor
    connect itsIoHwAb_AnalogIn.AI_SEAT_OCCUPTANT_FR -> itsSWC_PasSaf_ZCUP.AI_SEAT_OCCUPTANT_FR
    connect itsIoHwAb_AnalogIn.AI_SEAT_OCCUPTANT_MID -> itsSWC_PasSaf_ZCUP.AI_SEAT_OCCUPTANT_MID
    connect itsIoHwAb_AnalogIn.AI_SEAT_OCCUPTANT_RR -> itsSWC_PasSaf_ZCUP.AI_SEAT_OCCUPTANT_RR
    connect itsIoHwAb_AnalogIn.AI_TCAN2451_VCC2 -> itsSWC_DrvierInformation.AI_TCAN2451_VCC2
    connect itsIoHwAb_AnalogIn.AI_UB_EXT3 -> itsSWC_PasSaf_ZCUP.AI_UB_EXT3
    connect itsIoHwAb_AnalogIn.AI_UB_EXT5 -> itsSWC_PasSaf_ZCUP.AI_UB_EXT5
    connect itsIoHwAb_DigIn.DIH_RL_TurnLight_Body_Diag -> itsAS_ExteriorLightIf.DIH_RL_TurnLight_Body_Diag
    connect itsIoHwAb_DigIn.DIH_RL_TurnLight_Tailgate_Diag -> itsAS_ExteriorLightIf.DIH_RL_TurnLight_Tailgate_Diag
    connect itsIoHwAb_DigIn.DIH_RR_TurnLight_Body_Diag -> itsAS_ExteriorLightIf.DIH_RR_TurnLight_Body_Diag
    connect itsIoHwAb_DigIn.DIH_RR_TurnLight_Tailgate_Diag -> itsAS_ExteriorLightIf.DIH_RR_TurnLight_Tailgate_Diag
    connect itsIoHwAb_PwmOut.DOH_PWM_AD_DYNAMIC_IND -> itsAS_ExteriorLightIf.DOH_PWM_AD_DYNAMIC_IND
    connect itsIoHwAb_PwmOut.DOH_PWM_AD_IND_FR -> itsAS_ExteriorLightIf.DOH_PWM_AD_IND_FR
    connect itsIoHwAb_PwmOut.DOH_PWM_AD_IND_RR -> itsAS_ExteriorLightIf.DOH_PWM_AD_IND_RR
    connect itsIoHwAb_PwmOut.DOH_PWM_AD_LIGHT_DYNAMIC_ENABLE -> itsAS_ExteriorLightIf.DOH_PWM_AD_LIGHT_DYNAMIC_ENABLE
    connect itsIoHwAb_PwmOut.DOH_PWM_CAMERA_HEATING_DEFORSTING_F -> itsSWC_DrvierInformation.DOH_PWM_CAMERA_HEATING_DEFORSTING_F
    connect itsIoHwAb_PwmOut.DOH_PWM_FRONT_CAMERA_WINDOW_HEATING -> itsSWC_DrvierInformation.DOH_PWM_FRONT_CAMERA_WINDOW_HEATING
    connect itsIoHwAb_PwmOut.DOH_PWM_Fog_Light_Rear -> itsCDD_OM_ZCUP.PWM_Fog_Light_Rear
    connect itsIoHwAb_PwmOut.DOH_PWM_LEFT_SIDE_INDICATION_SUPPLY -> itsCDD_TurnLight_ZCUP_safe.DOH_PWM_LEFT_SIDE_INDICATION_SUPPLY
    connect itsIoHwAb_PwmOut.DOH_PWM_LicensePlate_Light -> itsCDD_OM_ZCUP.PWM_LicensePlate_Light
    connect itsIoHwAb_PwmOut.DOH_PWM_PASS_SIDE_AD_IND -> itsAS_ExteriorLightIf.DOH_PWM_PASS_SIDE_AD_IND
    connect itsIoHwAb_PwmOut.DOH_PWM_POSITION_LIGHT_RR -> itsCDD_PosnLamp_ZCUP_Safe.DOH_PWM_Position_Light_RR
    connect itsIoHwAb_PwmOut.DOH_PWM_RIGHT_SIDE_INDICATION_SUPPLY -> itsCDD_TurnLight_ZCUP_safe.DOH_PWM_RIGHT_SIDE_INDICATION_SUPPLY
    connect itsIoHwAb_PwmOut.DOH_PWM_Reverse_Light -> itsCDD_OM_ZCUP.PWM_Reverse_Light
    connect itsIoHwAb_PwmOut.DOH_PWM_Turn_Light_RL -> itsCDD_TurnLight_ZCUP_safe.DOH_PWM_Turn_Light_RL
    connect itsIoHwAb_PwmOut.DOH_PWM_Turn_Light_RR -> itsCDD_TurnLight_ZCUP_safe.DOH_PWM_Turn_Light_RR
    connect itsIoHwAb_SmartDiag.DOH_PWM_AD_IND_FR_SmartDiag -> itsAS_ExteriorLightIf.DOH_PWM_AD_IND_FR_SmartDiag
    connect itsIoHwAb_SmartDiag.DOH_PWM_AD_IND_RR_SmartDiag -> itsAS_ExteriorLightIf.DOH_PWM_AD_IND_RR_SmartDiag
    connect itsIoHwAb_SmartDiag.DOH_PWM_AD_LIGHT_DYNAMIC_ENABLE_SmartDiag -> itsAS_ExteriorLightIf.DOH_PWM_AD_LIGHT_DYNAMIC_ENABLE_SmartDiag
    connect itsIoHwAb_SmartDiag.DOH_PWM_FRONT_CAMERA_WINDOW_HEATING_SmartDiag -> itsSWC_DrvierInformation.AI_HSD_DIAG03
    connect itsIoHwAb_SmartDiag.DOH_PWM_Fog_Light_Rear_SmartDiag -> itsAS_ExteriorLightIf.DOH_PWM_Fog_Light_Rear_SmartDiag
    connect itsIoHwAb_SmartDiag.DOH_PWM_LEFT_SIDE_INDICATION_SUPPLY_SmartDiag -> itsAS_ExteriorLightIf.DOH_PWM_LEFT_SIDE_INDICATION_SUPPLY_SmartDiag
    connect itsIoHwAb_SmartDiag.DOH_PWM_LicensePlate_Light_SmartDiag -> itsAS_ExteriorLightIf.DOH_PWM_LicensePlate_Light_SmartDiag
    connect itsIoHwAb_SmartDiag.DOH_PWM_PASS_SIDE_AD_IND_SmartDiag -> itsAS_ExteriorLightIf.DOH_PWM_PASS_SIDE_AD_IND_SmartDiag
    connect itsIoHwAb_SmartDiag.DOH_PWM_POSITION_LIGHT_RR_SmartDiag -> itsAS_ExteriorLightIf.DOH_PWM_POSITION_LIGHT_RR_SmartDiag
    connect itsIoHwAb_SmartDiag.DOH_PWM_RIGHT_SIDE_INDICATION_SUPPLY_SmartDiag -> itsAS_ExteriorLightIf.DOH_PWM_RIGHT_SIDE_INDICATION_SUPPLY_SmartDiag
    connect itsIoHwAb_SmartDiag.DOH_PWM_Reverse_Light_SmartDiag -> itsAS_ExteriorLightIf.DOH_PWM_Reverse_Light_SmartDiag
    connect itsIoHwAb_SmartDiag.DOH_PWM_Turn_Light_RL_SmartDiag -> itsAS_ExteriorLightIf.DOH_PWM_Turn_Light_RL_SmartDiag
    connect itsIoHwAb_SmartDiag.DOH_PWM_Turn_Light_RR_SmartDiag -> itsAS_ExteriorLightIf.DOH_PWM_Turn_Light_RR_SmartDiag
    connect itsIoHwAb_Tle75xxx.DOH_REAR_SWIPING_ENABLE -> itsAS_ExteriorLightIfCore1.DOH_REAR_SWIPING_ENABLE
    connect itsMirrorWrapper.ExtTle9166OutCheck -> itsAS_ExteriorLightIf.ExtTle9166OutCheck
    delegate itsAS_InteriorLightIf.ALM1Diag{10..16} <-> outer port ALM1Diag{10..16}
    delegate itsAS_InteriorLightIf.ALM1Diag{1..9} <-> outer port ALM1Diag{1..9}
    delegate itsAS_InteriorLightIf.ALM2Diag{10..16} <-> outer port ALM2Diag{10..16}
    delegate itsAS_InteriorLightIf.ALM2Diag{1..9} <-> outer port ALM2Diag{1..9}
