AUTOSAR XML (schema 00048)
package /ECUExtractZCUP/VehicleProject
  system SDB326300: category=ECU_EXTRACT, system-version=13.54.06;2026/08/12, System.Ver: 0
    system mapping SystemMapping_McSystemImpl
      sw-impl-mappings:
        9 x swc to impl mapping:
          itsCCMWrapper_ImplMapping: component-implementation=imp_CCMWrapper, component=TopLevelComposition.ZCUP5.itsCCMWrapper
          itsCDD_Seat_Pass_ImplMapping: component-implementation=IMP_CDD_Seat_Pass, component=TopLevelComposition.ZCUP5.itsCDD_Seat_Pass
          itsDatamon_CDD_ImplMapping: component-implementation=Datamon_Implementation, component=TopLevelComposition.ZCUP5.itsDatamon_CDD
          itsMcAdapter_CoreA_ImplMapping: component-implementation=Impl_McAdapter_CoreA, component=TopLevelComposition.ZCUP5.itsMcAdapter_CoreA
          itsMirrorWrapper_ImplMapping: component-implementation=impMirrorWrapper, component=TopLevelComposition.ZCUP5.itsMirrorWrapper
          itsPBM_CDD_ImplMapping: component-implementation=PBM_Implementation, component=TopLevelComposition.ZCUP5.itsPBM_CDD
          itsSeat_Model_ImplMapping: component-implementation=Seat_Model_Impl, component=TopLevelComposition.ZCUP5.itsSeat_Model
          itsSpiderAdapter_ImplMapping: component-implementation=Impl_SpiderAdapter, component=TopLevelComposition.ZCUP5.itsSpiderAdapter
          itsWLWrapper_ImplMapping: component-implementation=impWLWrapper, component=TopLevelComposition.ZCUP5.itsWLWrapper
      sw-mappings:
        swc to ecu mapping SwcToEcuMapping: ecu-instance=ZCUP5
          component:
            TopLevelComposition.ZCUP5.Conti_SWC_FDLib
            TopLevelComposition.ZCUP5.itsCCMWrapper
            TopLevelComposition.ZCUP5.itsCDD_Seat_Pass
            TopLevelComposition.ZCUP5.itsDatamon_CDD
            TopLevelComposition.ZCUP5.itsMcAdapter_CoreA
            TopLevelComposition.ZCUP5.itsMirrorWrapper
            TopLevelComposition.ZCUP5.itsPBM_CDD
            TopLevelComposition.ZCUP5.itsSeat_Model
            TopLevelComposition.ZCUP5.itsSpiderAdapter
            TopLevelComposition.ZCUP5.itsWLWrapper
    root-software-compositions:
      root sw composition prototype TopLevelComposition: software-composition=TopLevelComposition
package /SwComponentType
  composition sw component type ZCUP5
    10 x component:
      Conti_SWC_FDLib: type=Conti_SWC_FDLib
      itsCCMWrapper: type=CCMWrapper
      itsCDD_Seat_Pass: type=CDD_Seat_Pass
      itsDatamon_CDD: type=Datamon_CDD
      itsMcAdapter_CoreA: type=McAdapter_CoreA
      itsMirrorWrapper: type=MirrorWrapper
      itsPBM_CDD: type=PBM_CDD
      itsSeat_Model: type=Seat_Model
      itsSpiderAdapter: type=SpiderAdapter
      itsWLWrapper: type=WLWrapper
    connect Conti_SWC_FDLib.P_FrontWindowAntiPinchStatus -> itsWLWrapper.R_FrontWindowAntiPinchStatus
    connect Conti_SWC_FDLib.P_FrontWindowMotorTempStatus -> itsWLWrapper.R_Motor0_MotTemp
    connect Conti_SWC_FDLib.P_M1_CLOSE_AbsoluteVoltage -> itsWLWrapper.R_M1_CLOSE_AbsoluteVoltage
    connect Conti_SWC_FDLib.P_M1_OPEN_AbsoluteVoltage -> itsWLWrapper.R_M1_OPEN_AbsoluteVoltage
    connect Conti_SWC_FDLib.P_M2_CLOSE_AbsoluteVoltage -> itsWLWrapper.R_M2_CLOSE_AbsoluteVoltage
    connect Conti_SWC_FDLib.P_M2_OPEN_AbsoluteVoltage -> itsWLWrapper.R_M2_OPEN_AbsoluteVoltage
    connect Conti_SWC_FDLib.P_MVCO_PWR_WINDOW_FRONT_MvcoUMotContactOutput -> itsWLWrapper.R_PWR_WINDOW_FRONT_MvcoUMotContactOutput
    connect Conti_SWC_FDLib.P_MVCO_PWR_WINDOW_REAR_MvcoUMotContactOutput -> itsWLWrapper.R_PWR_WINDOW_REAR_MvcoUMotContactOutput
    connect Conti_SWC_FDLib.P_Motor0WblCpwl_DID_SetLowerBlockPosition -> itsWLWrapper.R_Motor0WblCpwl_DID_SetLowerBlockPosition
    connect Conti_SWC_FDLib.P_Motor0WblCpwl_DID_SetReferencePosition -> itsWLWrapper.R_Motor0WblCpwl_DID_SetReferencePosition
    connect Conti_SWC_FDLib.P_Motor0WblCpwl_ErrorReport -> itsWLWrapper.R_Motor0WblCpwl_ErrorReport0
    connect Conti_SWC_FDLib.P_Motor0WblCpwl_InitRoutineRequest -> itsWLWrapper.P_Motor0WblCpwl_InitRoutineRequest
    connect Conti_SWC_FDLib.P_Motor0WblCpwl_InitRoutineStatus -> itsWLWrapper.P_Motor0WblCpwl_InitRoutineStatus
    connect Conti_SWC_FDLib.P_Motor0WblCpwl_LastValidLowerBlockPosInfo -> itsWLWrapper.R_Motor0WblCpwl_LastValidLowerBlockPosInfo
    connect Conti_SWC_FDLib.P_Motor0WblCpwl_MotStatus -> itsWLWrapper.R_Motor0WblCpwl_MotStatus
    connect Conti_SWC_FDLib.P_Motor0WblCpwl_PosInfo -> itsWLWrapper.R_Motor0WblCpwl_PosInfo
    connect Conti_SWC_FDLib.P_Motor0WblCpwl_ReverseInfo -> itsWLWrapper.R_Motor0WblCpwl_ReverseInfo
    connect Conti_SWC_FDLib.P_Motor0WblCpwl_SelfDiag -> itsWLWrapper.R_Motor0WblCpwl_SelfDiag
    connect Conti_SWC_FDLib.P_Motor0WblCpwl_SoftStallPos -> itsWLWrapper.R_Motor0WblCpwl_SoftStallPos
    connect Conti_SWC_FDLib.P_Motor0WblCpwl_WinPosStatus -> itsWLWrapper.R_Motor0WblCpwl_WinPosStatus
    connect Conti_SWC_FDLib.P_Motor0WblCpwl_WindowControlNotif -> itsWLWrapper.R_Motor0WblCpwl_WindowControlNotif
    connect Conti_SWC_FDLib.P_Motor0WblCpwl_WindowEvent -> itsWLWrapper.R_Motor0WblCpwl_WindowEvent
    connect Conti_SWC_FDLib.P_Motor1WblCpwl_DID_SetLowerBlockPosition -> itsWLWrapper.R_Motor1WblCpwl_DID_SetLowerBlockPosition
    connect Conti_SWC_FDLib.P_Motor1WblCpwl_DID_SetReferencePosition -> itsWLWrapper.R_Motor1WblCpwl_DID_SetReferencePosition
    connect Conti_SWC_FDLib.P_Motor1WblCpwl_ErrorReport -> itsWLWrapper.R_Motor1WblCpwl_ErrorReport0
    connect Conti_SWC_FDLib.P_Motor1WblCpwl_InitRoutineRequest -> itsWLWrapper.P_Motor1WblCpwl_InitRoutineRequest
    connect Conti_SWC_FDLib.P_Motor1WblCpwl_InitRoutineStatus -> itsWLWrapper.P_Motor1WblCpwl_InitRoutineStatus
    connect Conti_SWC_FDLib.P_Motor1WblCpwl_LastValidLowerBlockPosInfo -> itsWLWrapper.R_Motor1WblCpwl_LastValidLowerBlockPosInfo
    connect Conti_SWC_FDLib.P_Motor1WblCpwl_MotStatus -> itsWLWrapper.R_Motor1WblCpwl_MotStatus
    connect Conti_SWC_FDLib.P_Motor1WblCpwl_PosInfo -> itsWLWrapper.R_Motor1WblCpwl_PosInfo
    connect Conti_SWC_FDLib.P_Motor1WblCpwl_ReverseInfo -> itsWLWrapper.R_Motor1WblCpwl_ReverseInfo
    connect Conti_SWC_FDLib.P_Motor1WblCpwl_SelfDiag -> itsWLWrapper.R_Motor1WblCpwl_SelfDiag
    connect Conti_SWC_FDLib.P_Motor1WblCpwl_SoftStallPos -> itsWLWrapper.R_Motor1WblCpwl_SoftStallPos
    connect Conti_SWC_FDLib.P_Motor1WblCpwl_WinPosStatus -> itsWLWrapper.R_Motor1WblCpwl_WinPosStatus
    connect Conti_SWC_FDLib.P_Motor1WblCpwl_WindowControlNotif -> itsWLWrapper.R_Motor1WblCpwl_WindowControlNotif
    connect Conti_SWC_FDLib.P_Motor1WblCpwl_WindowEvent -> itsWLWrapper.R_Motor1WblCpwl_WindowEvent
    connect Conti_SWC_FDLib.P_PWR_WINDOW_FRONT_MotCtrlHal_DriverPwmDutyCycle -> itsWLWrapper.R_PWR_WINDOW_FRONT_DriverDuty
    connect Conti_SWC_FDLib.P_PWR_WINDOW_FRONT_MotCtrlHal_MotorActiveStatus -> itsWLWrapper.R_PWR_WINDOW_FRONT_MotCtrlHal_MotorActiveStatus
    connect Conti_SWC_FDLib.P_PWR_WINDOW_FRONT_MotCtrlHal_MotorPwmFreqCtrl -> itsWLWrapper.R_PWR_WINDOW_FRONT_DriverFreq
    connect Conti_SWC_FDLib.P_PWR_WINDOW_FRONT_MotorHBridgeDirection -> itsWLWrapper.R_PWR_WINDOW_FRONT_hmoTiDrv870x_MotorHBridgeDirection
    connect Conti_SWC_FDLib.P_PWR_WINDOW_FRONT_RadioFreqAdapt -> itsWLWrapper.R_PWR_WINDOW_FRONT_RadioFreqAdapt
    connect Conti_SWC_FDLib.P_PWR_WINDOW_REAR_MotCtrlHal_DriverPwmDutyCycle -> itsWLWrapper.R_PWR_WINDOW_REAR_DriverDuty
    connect Conti_SWC_FDLib.P_PWR_WINDOW_REAR_MotCtrlHal_MotorActiveStatus -> itsWLWrapper.R_PWR_WINDOW_REAR_MotCtrlHal_MotorActiveStatus
    connect Conti_SWC_FDLib.P_PWR_WINDOW_REAR_MotCtrlHal_MotorPwmFreqCtrl -> itsWLWrapper.R_PWR_WINDOW_REAR_DriverFreq
    connect Conti_SWC_FDLib.P_PWR_WINDOW_REAR_MotorHBridgeDirection -> itsWLWrapper.R_PWR_WINDOW_REAR_hmoTiDrv870x_MotorHBridgeDirection
    connect Conti_SWC_FDLib.P_PWR_WINDOW_REAR_RadioFreqAdapt -> itsWLWrapper.R_PWR_WINDOW_REAR_RadioFreqAdapt
    connect Conti_SWC_FDLib.P_PowerMode_Seat -> itsCDD_Seat_Pass.R_ZCUX_ApmdPowerMode
    connect Conti_SWC_FDLib.P_PowerMode -> itsWLWrapper.R_APMDPowerMode
    connect Conti_SWC_FDLib.P_RearWindowAntiPinchStatus -> itsWLWrapper.R_RearWindowAntiPinchStatus
    connect Conti_SWC_FDLib.P_RearWindowMotorTempStatus -> itsWLWrapper.R_Motor1_MotTemp
    connect Conti_SWC_FDLib.P_Seat0AntiPinchCtrl -> itsSeat_Model.R_0AntiPinchCtrlsetAntipinchMode
    connect Conti_SWC_FDLib.P_Seat0AntiPinchStatus -> itsSeat_Model.R_0AntiPinchStatusgetAntipinchStatus
    connect Conti_SWC_FDLib.P_Seat0AxisCtrlWithPos -> itsSeat_Model.R_0AxisCtrlWithPosmoveToPosition
    connect Conti_SWC_FDLib.P_Seat0AxisCtrlWithoutPos -> itsSeat_Model.R_0AxisCtrlWithoutPosstartMotor
    connect Conti_SWC_FDLib.P_Seat0AxisCtrlWithoutPos -> itsSeat_Model.R_0AxisCtrlWithoutPosstopMotor
    connect Conti_SWC_FDLib.P_Seat0AxisMotorStatus -> itsSeat_Model.R_0AxisMotorStatusgetMotorStatus
    connect Conti_SWC_FDLib.P_Seat0AxisPositionCtrl -> itsSeat_Model.R_0AxisPositionCtrlsetReferencePosition
    connect Conti_SWC_FDLib.P_Seat0AxisPositionStatus -> itsSeat_Model.R_0AxisPositionStatusgetPosition
    connect Conti_SWC_FDLib.P_Seat0MotorSpeed -> itsSeat_Model.R_0MotorSpeedgetMotorSpeed
    connect Conti_SWC_FDLib.P_Seat0MotorTempStatus -> itsCDD_Seat_Pass.R_ZCUX_0MotorTempStatus
    connect Conti_SWC_FDLib.P_Seat1AntiPinchCtrl -> itsSeat_Model.R_1AntiPinchCtrlsetAntipinchMode
    connect Conti_SWC_FDLib.P_Seat1AntiPinchStatus -> itsSeat_Model.R_1AntiPinchStatusgetAntipinchStatus
    connect Conti_SWC_FDLib.P_Seat1AxisCtrlWithPos -> itsSeat_Model.R_1AxisCtrlWithPosmoveToPosition
    connect Conti_SWC_FDLib.P_Seat1AxisCtrlWithoutPos -> itsSeat_Model.R_1AxisCtrlWithoutPosstartMotor
    connect Conti_SWC_FDLib.P_Seat1AxisCtrlWithoutPos -> itsSeat_Model.R_1AxisCtrlWithoutPosstopMotor
    connect Conti_SWC_FDLib.P_Seat1AxisMotorStatus -> itsSeat_Model.R_1AxisMotorStatusgetMotorStatus
    connect Conti_SWC_FDLib.P_Seat1AxisPositionCtrl -> itsSeat_Model.R_1AxisPositionCtrlsetReferencePosition
    connect Conti_SWC_FDLib.P_Seat1AxisPositionStatus -> itsSeat_Model.R_1AxisPositionStatusgetPosition
    connect Conti_SWC_FDLib.P_Seat1MotorSpeed -> itsSeat_Model.R_1MotorSpeedgetMotorSpeed
    connect Conti_SWC_FDLib.P_Seat1MotorTempStatus -> itsCDD_Seat_Pass.R_ZCUX_1MotorTempStatus
    connect Conti_SWC_FDLib.P_Seat2AntiPinchCtrl -> itsSeat_Model.R_2AntiPinchCtrlsetAntipinchMode
    connect Conti_SWC_FDLib.P_Seat2AntiPinchStatus -> itsSeat_Model.R_2AntiPinchStatusgetAntipinchStatus
    connect Conti_SWC_FDLib.P_Seat2AxisCtrlWithPos -> itsSeat_Model.R_2AxisCtrlWithPosmoveToPosition
    connect Conti_SWC_FDLib.P_Seat2AxisCtrlWithoutPos -> itsSeat_Model.R_2AxisCtrlWithoutPosstartMotor
    connect Conti_SWC_FDLib.P_Seat2AxisCtrlWithoutPos -> itsSeat_Model.R_2AxisCtrlWithoutPosstopMotor
    connect Conti_SWC_FDLib.P_Seat2AxisMotorStatus -> itsSeat_Model.R_2AxisMotorStatusgetMotorStatus
    connect Conti_SWC_FDLib.P_Seat2AxisPositionCtrl -> itsSeat_Model.R_2AxisPositionCtrlsetReferencePosition
    connect Conti_SWC_FDLib.P_Seat2AxisPositionStatus -> itsSeat_Model.R_2AxisPositionStatusgetPosition
    connect Conti_SWC_FDLib.P_Seat2MotorSpeed -> itsSeat_Model.R_2MotorSpeedgetMotorSpeed
    connect Conti_SWC_FDLib.P_Seat2MotorTempStatus -> itsCDD_Seat_Pass.R_ZCUX_2MotorTempStatus
    connect Conti_SWC_FDLib.P_Seat3AntiPinchCtrl -> itsSeat_Model.R_3AntiPinchCtrlsetAntipinchMode
    connect Conti_SWC_FDLib.P_Seat3AntiPinchStatus -> itsSeat_Model.R_3AntiPinchStatusgetAntipinchStatus
    connect Conti_SWC_FDLib.P_Seat3AxisCtrlWithPos -> itsSeat_Model.R_3AxisCtrlWithPosmoveToPosition
    connect Conti_SWC_FDLib.P_Seat3AxisCtrlWithoutPos -> itsSeat_Model.R_3AxisCtrlWithoutPosstartMotor
    connect Conti_SWC_FDLib.P_Seat3AxisCtrlWithoutPos -> itsSeat_Model.R_3AxisCtrlWithoutPosstopMotor
    connect Conti_SWC_FDLib.P_Seat3AxisMotorStatus -> itsSeat_Model.R_3AxisMotorStatusgetMotorStatus
    connect Conti_SWC_FDLib.P_Seat3AxisPositionCtrl -> itsSeat_Model.R_3AxisPositionCtrlsetReferencePosition
    connect Conti_SWC_FDLib.P_Seat3AxisPositionStatus -> itsSeat_Model.R_3AxisPositionStatusgetPosition
    connect Conti_SWC_FDLib.P_Seat3MotorSpeed -> itsSeat_Model.R_3MotorSpeedgetMotorSpeed
    connect Conti_SWC_FDLib.P_Seat3MotorTempStatus -> itsCDD_Seat_Pass.R_ZCUX_3MotorTempStatus
    connect Conti_SWC_FDLib.P_UB_WINDOW_ADC1_AbsoluteVoltage -> itsWLWrapper.R_UB_WINDOW_REV_AbsoluteVoltage
    connect Conti_SWC_FDLib.P_WINDOW_FRONT_MotorHBridgeCtrlGeneralInstanceCtrl -> itsWLWrapper.R_PWR_WINDOW_FRONT_MotorHBridgeCtrlGeneralInstanceCtrl
    connect Conti_SWC_FDLib.P_WINDOW_REAR_MotorHBridgeCtrlGeneralInstanceCtrl -> itsWLWrapper.R_PWR_WINDOW_REAR_MotorHBridgeCtrlGeneralInstanceCtrl
    connect Conti_SWC_FDLib.P_WblCpwl_PwrMgnt -> itsWLWrapper.R_WblCpwl_PwrMgnt
    connect itsCDD_Seat_Pass.P_FrntHeiMotEna -> itsSeat_Model.FrntHeiMotEna
    connect itsCDD_Seat_Pass.P_HallSts_init -> itsSeat_Model.HallSts_init
    connect itsCDD_Seat_Pass.P_HeiMotEna -> itsSeat_Model.HeiMotEna
    connect itsCDD_Seat_Pass.P_InclMotEna -> itsSeat_Model.InclMotEna
    connect itsCDD_Seat_Pass.P_Mot_Error_Status -> itsSeat_Model.Mot_Error_Status
    connect itsCDD_Seat_Pass.P_SldMotEna -> itsSeat_Model.SldMotEna
    connect itsCDD_Seat_Pass.P_SnsrFaultDirNvM -> itsSeat_Model.SnsrFaultDirNvM
    connect itsCDD_Seat_Pass.P_ZCUX_0HallSensorEnable -> Conti_SWC_FDLib.R_Seat0HallSensorEnable
    connect itsCDD_Seat_Pass.P_ZCUX_0LoggingEvent -> Conti_SWC_FDLib.R_Seat0LoggingEvent
    connect itsCDD_Seat_Pass.P_ZCUX_1HallSensorEnable -> Conti_SWC_FDLib.R_Seat1HallSensorEnable
    connect itsCDD_Seat_Pass.P_ZCUX_1LoggingEvent -> Conti_SWC_FDLib.R_Seat1LoggingEvent
    connect itsCDD_Seat_Pass.P_ZCUX_2HallSensorEnable -> Conti_SWC_FDLib.R_Seat2HallSensorEnable
    connect itsCDD_Seat_Pass.P_ZCUX_2LoggingEvent -> Conti_SWC_FDLib.R_Seat2LoggingEvent
    connect itsCDD_Seat_Pass.P_ZCUX_3HallSensorEnable -> Conti_SWC_FDLib.R_Seat3HallSensorEnable
    connect itsCDD_Seat_Pass.P_ZCUX_3LoggingEvent -> Conti_SWC_FDLib.R_Seat3LoggingEvent
    connect itsCDD_Seat_Pass.P_ZCUX_IsrLock -> Conti_SWC_FDLib.R_IsrLock_Seat
    connect itsCDD_Seat_Pass.P_ZCUX_MechanicAmbientTemperature -> Conti_SWC_FDLib.R_MechanicAmbientTemperature_Seat
    connect itsCDD_Seat_Pass.P_ZCUX_MotorAmbientTemperature -> Conti_SWC_FDLib.R_MotorAmbientTemperature_Seat
    connect itsCDD_Seat_Pass.P_ZCUX_SystemTime -> Conti_SWC_FDLib.R_SystemTime_Seat
    connect itsCDD_Seat_Pass.P_ZCUX_VehicleSpeed -> Conti_SWC_FDLib.R_VehicleSpeed_Seat
    connect itsCDD_Seat_Pass.P_ext_inhibit_anti_pinch -> itsSeat_Model.ext_inhibit_anti_pinch
    connect itsCDD_Seat_Pass.P_ext_init_ref_data -> itsSeat_Model.ext_init_ref_data
    connect itsCDD_Seat_Pass.P_ext_init_ref_status -> itsSeat_Model.ext_init_ref_status
    connect itsCDD_Seat_Pass.P_ext_init_ref_trigger -> itsSeat_Model.ext_init_ref_trigger
    connect itsCDD_Seat_Pass.P_ext_reset_diag -> itsSeat_Model.ext_reset_diag
    connect itsCDD_Seat_Pass.pSeatAdj_TestFailed -> itsDTCMgr.SeatAdj_TestFailed
    connect itsCDD_Seat_Pass.pSeatAdj_TestPassed -> itsDTCMgr.SeatAdj_TestPassed
    connect itsCDD_Seat_Pass.pSeatLumb_TestFailed -> itsDTCMgr.SeatLumb_TestFailed
    connect itsCDD_Seat_Pass.pSeatLumb_TestPassed -> itsDTCMgr.SeatLumb_TestPassed
    connect itsCDD_Seat_Pass.pSeatMassg_TestFailed -> itsDTCMgr.SeatMassg_TestFailed
    connect itsCDD_Seat_Pass.pSeatMassg_TestPassed -> itsDTCMgr.SeatMassg_TestPassed
    connect itsCDD_Seat_Pass.pSeatSwitch_TestFailed -> itsDTCMgr.SeatSwitch_TestFailed
    connect itsCDD_Seat_Pass.pSeatSwitch_TestPassed -> itsDTCMgr.SeatSwitch_TestPassed
    connect itsCddTcan4x5x.GetWakeInput -> itsMcAdapter_CoreA.GetWakeInput
    connect itsDiagMgr.DiagCtrlSubst4096_1_PWMValueSwt -> itsWLWrapper.DiagCtrlSubst4096_1_PWMValueSwt
    connect itsDiagMgr.DiagCtrlSubst4096_1_PWMValueValue -> itsWLWrapper.DiagCtrlSubst4096_1_PWMValueValue
    connect itsDiagMgr.DiagCtrlSubst4096_2_TargetPositionSwt -> itsWLWrapper.DiagCtrlSubst4096_2_TargetPositionSwt
    connect itsDiagMgr.DiagCtrlSubst4096_2_TargetPositionValue -> itsWLWrapper.DiagCtrlSubst4096_2_TargetPositionValue
    connect itsDiagMgr.DiagCtrlSubst409D_1_PWMValueSwt -> itsWLWrapper.DiagCtrlSubst409D_1_PWMValueSwt
    connect itsDiagMgr.DiagCtrlSubst409D_1_PWMValueValue -> itsWLWrapper.DiagCtrlSubst409D_1_PWMValueValue
    connect itsDiagMgr.DiagCtrlSubst409D_2_TargetPositionSwt -> itsWLWrapper.DiagCtrlSubst409D_2_TargetPositionSwt
    connect itsDiagMgr.DiagCtrlSubst409D_2_TargetPositionValue -> itsWLWrapper.DiagCtrlSubst409D_2_TargetPositionValue
    connect itsDiagMgr.DiagCtrlSubstWindowLifterWrpr -> itsWLWrapper.DiagCtrlSubstWindowLifterWrpr
    connect itsHWDiagSpider.PP_HWDiagSpider_IOFaultState_Channel0 -> itsMcAdapter_CoreA.HWDiagSpider_IOFaultState_CH00
    connect itsHWDiagSpider.PP_HWDiagSpider_IOFaultState_Channel1 -> itsMcAdapter_CoreA.HWDiagSpider_IOFaultState_CH01
    connect itsHWDiagSpider.PP_HWDiagSpider_IOFaultState_Channel2 -> itsMcAdapter_CoreA.HWDiagSpider_IOFaultState_CH02
    connect itsHWDiagSpider.PP_HWDiagSpider_IOFaultState_Channel3 -> itsMcAdapter_CoreA.HWDiagSpider_IOFaultState_CH03
    connect itsHWDiagSpider.PP_HWDiagSpider_IOFaultState_Channel4 -> itsMcAdapter_CoreA.HWDiagSpider_IOFaultState_CH04
    connect itsHWDiagSpider.PP_HWDiagSpider_IOFaultState_Channel5 -> itsMcAdapter_CoreA.HWDiagSpider_IOFaultState_CH05
    connect itsHWDiagSpider.PP_HWDiagSpider_IOFaultState_Channel6 -> itsMcAdapter_CoreA.HWDiagSpider_IOFaultState_CH06
    connect itsHWDiagSpider.PP_HWDiagSpider_IOFaultState_Channel7 -> itsMcAdapter_CoreA.HWDiagSpider_IOFaultState_CH07
    connect itsIoHwAb_AnalogIn.AI_FR_WindowLocalSW -> itsWLWrapper.AI_FR_WindowLocalSW
    connect itsIoHwAb_AnalogIn.AI_RR_WindowLocalSW -> itsWLWrapper.AI_RR_WindowLocalSW
    connect itsIoHwAb_ProxyMgr_OsApplication_C1_P0.AI_EVAP_VALVE_STATUS_FB -> itsCCMWrapper.R_AI_EVAP_VALVE_STATUS_FB
    connect itsIoHwAb_ProxyMgr_OsApplication_C1_P0.AI_FBLW_LPM_DIAG -> itsCCMWrapper.R_AI_FBLW_LPM_DIAG
    connect itsIoHwAb_ProxyMgr_OsApplication_C1_P0.AI_FDefrostFMPosFB_REV -> itsCCMWrapper.R_AI_FDefrostFMPosFB_REV
    connect itsIoHwAb_ProxyMgr_OsApplication_C1_P0.AI_FLTempFMPosFB -> itsCCMWrapper.R_AI_FLTempFMPosFB
    connect itsIoHwAb_ProxyMgr_OsApplication_C1_P0.AI_FRTempFMPosFB -> itsCCMWrapper.R_AI_FRTempFMPosFB
    connect itsIoHwAb_ProxyMgr_OsApplication_C1_P0.AI_FVentModeFMPosFB -> itsCCMWrapper.R_AI_FVentModeFMPosFB
    connect itsIoHwAb_ProxyMgr_OsApplication_C1_P0.AI_RVentModeFMPosFB_REV -> itsCCMWrapper.R_AI_RVentModeFMPosFB_REV
    connect itsIoHwAb_ProxyMgr_OsApplication_C1_P0.AI_RearTempFMPosFB_REV -> itsCCMWrapper.R_AI_RearTempFMPosFB_REV
    connect itsIoHwAb_ProxyMgr_OsApplication_C1_P0.AI_RecirculationFMPosFB -> itsCCMWrapper.R_AI_RecirculationFMPosFB
    connect itsIoHwAb_ProxyMgr_OsApplication_C1_P0.AI_TCAN2451_VCC2 -> itsCCMWrapper.R_AI_TCAN2451_VCC2
    connect itsIoHwAb_ProxyMgr_OsApplication_C1_P0.AI_TEMP_FEET_FL_KX -> itsCCMWrapper.R_AI_TEMP_FEET_FL_KX
    connect itsIoHwAb_ProxyMgr_OsApplication_C1_P0.AI_TEMP_FEET_FR_KX -> itsCCMWrapper.R_AI_TEMP_FEET_FR_KX
    connect itsIoHwAb_ProxyMgr_OsApplication_C1_P0.AI_TEMP_FINCAR -> itsCCMWrapper.R_AI_TEMP_FINCAR
    connect itsIoHwAb_ProxyMgr_OsApplication_C1_P0.AI_TEMP_HEX_RIGHT -> itsCCMWrapper.R_AI_TEMP_HEX_RIGHT
    connect itsIoHwAb_ProxyMgr_OsApplication_C1_P0.AI_TEMP_PANEL_FL_KE -> itsCCMWrapper.R_AI_TEMP_PANEL_FL_KE
    connect itsIoHwAb_ProxyMgr_OsApplication_C1_P0.AI_TEMP_PANEL_FR_KX_EX -> itsCCMWrapper.R_AI_TEMP_PANEL_FR_KX_EX
    connect itsIoHwAb_ProxyMgr_OsApplication_C1_P0.AI_TEMP_REAR_EVAP -> itsCCMWrapper.R_AI_TEMP_REAR_EVAP
    connect itsIoHwAb_ProxyMgr_OsApplication_C1_P0.AI_TEMP_REAR_INTERIOR -> itsCCMWrapper.R_AI_TEMP_REAR_INTERIOR
    connect itsIoHwAb_ProxyMgr_OsApplication_C1_P0.AI_TEMP_RINCAR -> itsCCMWrapper.R_AI_TEMP_RINCAR
    connect itsIoHwAb_ProxyMgr_OsApplication_C1_P0.AI_Temp_Feet_SR_EX_REV -> itsCCMWrapper.R_AI_Temp_Feet_SR_EX_REV
    connect itsIoHwAb_ProxyMgr_OsApplication_C1_P0.AI_Temp_Front_EVAP -> itsCCMWrapper.R_AI_TEMP_FRONT_EVAP
    connect itsIoHwAb_ProxyMgr_OsApplication_C1_P0.AI_Temp_Hex -> itsCCMWrapper.R_AI_Temp_Hex
    connect itsIoHwAb_ProxyMgr_OsApplication_C1_P0.AI_Temp_Panel_SR_EX_REV -> itsCCMWrapper.R_AI_Temp_Panel_SR_EX_REV
    connect itsIoHwAb_ProxyMgr_OsApplication_C1_P0.AI_VM_FBLW_LPMM -> itsCCMWrapper.R_AI_VM_FBLW_LPMM
    connect itsIoHwAb_ProxyMgr_OsApplication_C1_P0.AI_VM_FBLW_LPMP -> itsCCMWrapper.R_AI_VM_FBLW_LPMP
    connect itsIoHwAb_ProxyMgr_OsApplication_C1_P0.DOH_FBLW_LPM_EN -> itsCCMWrapper.R_DOH_FBLW_LPM_EN
    connect itsIoHwAb_ProxyMgr_OsApplication_C1_P0.DOH_PWM_FBLW_LPM_OUT -> itsCCMWrapper.R_DOH_PWM_FBLW_LPM_OUT
    connect itsIoHwAb_ProxyMgr_OsApplication_C1_P0.DOH_PWM_SEAT_HEAT_AND_VENT_INDICATOR -> itsSpiderAdapter.IoHwAb_ProxyMgr_PwmOut
    connect itsMcAdapter_CoreA.SpiderAd_SetDiscrete -> itsSpiderAdapter.SpiderAd_SetDiscrete
    connect itsMcAdapter_CoreA.SpiderAd_SetDutyCycle -> itsSpiderAdapter.SpiderAd_SetDutyCycle
    connect itsSeat_Model.DrvrSeatPosPerc -> itsCDD_Seat_Pass.R_DrvrSeatPosPerc
    connect itsSeat_Model.FrntHeiHallSts -> itsCDD_Seat_Pass.R_FrntHeiHallSts
    connect itsSeat_Model.HeiHallSts -> itsCDD_Seat_Pass.R_HeiHallSts
    connect itsSeat_Model.HwRowFrstDrvrFrntHeiMotCal -> itsCDD_Seat_Pass.R_HwRowFrstDrvrFrntHeiMotCal
    connect itsSeat_Model.HwRowFrstDrvrHeiMotCal -> itsCDD_Seat_Pass.R_HwRowFrstDrvrHeiMotCal
    connect itsSeat_Model.HwRowFrstDrvrInclMotCal -> itsCDD_Seat_Pass.R_HwRowFrstDrvrInclMotCal
    connect itsSeat_Model.HwRowFrstDrvrSldMotCal -> itsCDD_Seat_Pass.R_HwRowFrstDrvrSldMotCal
    connect itsSeat_Model.HwSeatRowFrstDrvrFrntHeiHallFltSts -> itsCDD_Seat_Pass.R_HwSeatRowFrstDrvrFrntHeiHallFltSts
    connect itsSeat_Model.HwSeatRowFrstDrvrFrntHeiMotFltSts -> itsCDD_Seat_Pass.R_HwSeatRowFrstDrvrFrntHeiMotFltSts
    connect itsSeat_Model.HwSeatRowFrstDrvrFrntHeiMotSts -> itsCDD_Seat_Pass.R_HwSeatRowFrstDrvrFrntHeiMotSts
    connect itsSeat_Model.HwSeatRowFrstDrvrHeiHallFltSts -> itsCDD_Seat_Pass.R_HwSeatRowFrstDrvrHeiHallFltSts
    connect itsSeat_Model.HwSeatRowFrstDrvrHeiMotFltSts -> itsCDD_Seat_Pass.R_HwSeatRowFrstDrvrHeiMotFltSts
    connect itsSeat_Model.HwSeatRowFrstDrvrHeiMotSts -> itsCDD_Seat_Pass.R_HwSeatRowFrstDrvrHeiMotSts
    connect itsSeat_Model.HwSeatRowFrstDrvrInclHallFltSts -> itsCDD_Seat_Pass.R_HwSeatRowFrstDrvrInclHallFltSts
    connect itsSeat_Model.HwSeatRowFrstDrvrInclMotSts -> itsCDD_Seat_Pass.R_HwSeatRowFrstDrvrInclMotSts
    connect itsSeat_Model.HwSeatRowFrstDrvrIndApSt -> itsCDD_Seat_Pass.R_HwSeatRowFrstDrvrIndApSt
    connect itsSeat_Model.HwSeatRowFrstDrvrIndMotFltSts -> itsCDD_Seat_Pass.R_HwSeatRowFrstDrvrIndMotFltSts
    connect itsSeat_Model.HwSeatRowFrstDrvrSIdMotSts -> itsCDD_Seat_Pass.R_HwSeatRowFrstDrvrSIdMotSts
    connect itsSeat_Model.HwSeatRowFrstDrvrSldApSt -> itsCDD_Seat_Pass.R_HwSeatRowFrstDrvrSldApSt
    connect itsSeat_Model.HwSeatRowFrstDrvrSldHallFltSts -> itsCDD_Seat_Pass.R_HwSeatRowFrstDrvrSldHallFltSts
    connect itsSeat_Model.HwSeatRowFrstDrvrSldMotFltSts -> itsCDD_Seat_Pass.R_HwSeatRowFrstDrvrSldMotFltSts
    connect itsSeat_Model.InclAPForceEna -> itsCDD_Seat_Pass.R_InclAPForceEna
    connect itsSeat_Model.InclHallSts -> itsCDD_Seat_Pass.R_InclHallSts
    connect itsSeat_Model.P_0APMD_ErrorStatusReport -> Conti_SWC_FDLib.R_Seat0APMD_ErrorStatusReport
    connect itsSeat_Model.P_0AP_ErrorStatusReport -> Conti_SWC_FDLib.R_Seat0AP_ErrorStatusReport
    connect itsSeat_Model.P_0MPOHALL_ErrorStatusReport -> Conti_SWC_FDLib.R_Seat0MPOHALL_ErrorStatusReport
    connect itsSeat_Model.P_0MotCtrlEvent -> Conti_SWC_FDLib.R_Seat0MotCtrlEvent
    connect itsSeat_Model.P_0MotorBlockBehaviour -> Conti_SWC_FDLib.R_Seat0MotorBlockBehaviour
    connect itsSeat_Model.P_0MtrCtrl_ErrorStatusReport -> Conti_SWC_FDLib.R_Seat0MtrCtrl_ErrorStatusReport
    connect itsSeat_Model.P_0PinchBehaviour -> Conti_SWC_FDLib.R_Seat0PinchBehaviour
    connect itsSeat_Model.P_1APMD_ErrorStatusReport -> Conti_SWC_FDLib.R_Seat1APMD_ErrorStatusReport
    connect itsSeat_Model.P_1AP_ErrorStatusReport -> Conti_SWC_FDLib.R_Seat1AP_ErrorStatusReport
    connect itsSeat_Model.P_1MPOHALL_ErrorStatusReport -> Conti_SWC_FDLib.R_Seat1MPOHALL_ErrorStatusReport
    connect itsSeat_Model.P_1MotCtrlEvent -> Conti_SWC_FDLib.R_Seat1MotCtrlEvent
    connect itsSeat_Model.P_1MotorBlockBehaviour -> Conti_SWC_FDLib.R_Seat1MotorBlockBehaviour
    connect itsSeat_Model.P_1MtrCtrl_ErrorStatusReport -> Conti_SWC_FDLib.R_Seat1MtrCtrl_ErrorStatusReport
    connect itsSeat_Model.P_1PinchBehaviour -> Conti_SWC_FDLib.R_Seat1PinchBehaviour
    connect itsSeat_Model.P_2APMD_ErrorStatusReport -> Conti_SWC_FDLib.R_Seat2APMD_ErrorStatusReport
    connect itsSeat_Model.P_2AP_ErrorStatusReport -> Conti_SWC_FDLib.R_Seat2AP_ErrorStatusReport
    connect itsSeat_Model.P_2MPOHALL_ErrorStatusReport -> Conti_SWC_FDLib.R_Seat2MPOHALL_ErrorStatusReport
    connect itsSeat_Model.P_2MotCtrlEvent -> Conti_SWC_FDLib.R_Seat2MotCtrlEvent
    connect itsSeat_Model.P_2MotorBlockBehaviour -> Conti_SWC_FDLib.R_Seat2MotorBlockBehaviour
    connect itsSeat_Model.P_2MtrCtrl_ErrorStatusReport -> Conti_SWC_FDLib.R_Seat2MtrCtrl_ErrorStatusReport
    connect itsSeat_Model.P_2PinchBehaviour -> Conti_SWC_FDLib.R_Seat2PinchBehaviour
    connect itsSeat_Model.P_3APMD_ErrorStatusReport -> Conti_SWC_FDLib.R_Seat3APMD_ErrorStatusReport
    connect itsSeat_Model.P_3AP_ErrorStatusReport -> Conti_SWC_FDLib.R_Seat3AP_ErrorStatusReport
    connect itsSeat_Model.P_3MPOHALL_ErrorStatusReport -> Conti_SWC_FDLib.R_Seat3MPOHALL_ErrorStatusReport
    connect itsSeat_Model.P_3MotCtrlEvent -> Conti_SWC_FDLib.R_Seat3MotCtrlEvent
    connect itsSeat_Model.P_3MotorBlockBehaviour -> Conti_SWC_FDLib.R_Seat3MotorBlockBehaviour
    connect itsSeat_Model.P_3MtrCtrl_ErrorStatusReport -> Conti_SWC_FDLib.R_Seat3MtrCtrl_ErrorStatusReport
    connect itsSeat_Model.P_3PinchBehaviour -> Conti_SWC_FDLib.R_Seat3PinchBehaviour
    connect itsSeat_Model.SeatDrvrCurrPosn -> itsCDD_Seat_Pass.R_SeatDrvrCurrPosn
    connect itsSeat_Model.SldAPForceEna -> itsCDD_Seat_Pass.R_SldAPForceEna
    connect itsSeat_Model.SldHallSts -> itsCDD_Seat_Pass.R_SldHallSts
    connect itsWLWrapper.DcuDemTestFailed -> itsDTCMgr.DcuDemTestFailed
    connect itsWLWrapper.DcuDemTestPassed -> itsDTCMgr.DcuDemTestPassed
    connect itsWLWrapper.DiagDID4096_1_PWMValue -> itsDiagMgr.DiagDID4096_1_PWMValue
    connect itsWLWrapper.DiagDID4096_2_TargetPosition -> itsDiagMgr.DiagDID4096_2_TargetPosition
    connect itsWLWrapper.DiagDID409D_1_PWMValue -> itsDiagMgr.DiagDID409D_1_PWMValue
    connect itsWLWrapper.DiagDID409D_2_TargetPosition -> itsDiagMgr.DiagDID409D_2_TargetPosition
    connect itsWLWrapper.DiagDIDWindowLifterWrpr -> itsDiagMgr.DiagDIDWindowLifterWrpr
    connect itsWLWrapper.KL30_1_Voltage -> itsCCMWrapper.KL30_1_Voltage
    connect itsWLWrapper.KL30_2_Voltage -> itsCCMWrapper.KL30_2_Voltage
    connect itsWLWrapper.P_MechanicAmbientTemperature -> Conti_SWC_FDLib.R_MechanicAmbientTemperature
    connect itsWLWrapper.P_Motor0WblCpwl_AntiPinchData_DID -> Conti_SWC_FDLib.R_Motor0WblCpwl_AntiPinchData_DID
    connect itsWLWrapper.P_Motor0WblCpwl_AntiPinchReserve_DID -> Conti_SWC_FDLib.R_Motor0WblCpwl_AntiPinchReserve_DID
    connect itsWLWrapper.P_Motor0WblCpwl_DID -> Conti_SWC_FDLib.R_Motor0WblCpwl_DID
    connect itsWLWrapper.P_Motor0WblCpwl_DenormPosition_SR -> Conti_SWC_FDLib.R_Motor0WblCpwl_DenormPosition_SR
    connect itsWLWrapper.P_Motor0WblCpwl_DoorStatus -> Conti_SWC_FDLib.R_Motor0WblCpwl_DoorStatus_SR
    connect itsWLWrapper.P_Motor0WblCpwl_ErrorReport -> Conti_SWC_FDLib.R_Motor0WblCpwl_ErrorReport
    connect itsWLWrapper.P_Motor0WblCpwl_GetReservedSelfDiagInfo -> Conti_SWC_FDLib.R_Motor0WblCpwl_GetReservedSelfDiagInfo
    connect itsWLWrapper.P_Motor0WblCpwl_MotorEvent -> Conti_SWC_FDLib.R_Motor0WblCpwl_MotorEvent
    connect itsWLWrapper.P_Motor0WblCpwl_PinchDetected -> Conti_SWC_FDLib.R_Motor0WblCpwl_PinchDetected
    connect itsWLWrapper.P_Motor0WblCpwl_SlpMotorAdaption_DID -> Conti_SWC_FDLib.R_Motor0WblCpwl_SlpMotorAdaption_DID
    connect itsWLWrapper.P_Motor0WblCpwl_TargetSpeed_DID -> Conti_SWC_FDLib.R_Motor0WblCpwl_TargetSpeed_DID
    connect itsWLWrapper.P_Motor0WblCpwl_WindowControl_SR -> Conti_SWC_FDLib.R_Motor0WblCpwl_WindowControl_SR
    connect itsWLWrapper.P_Motor0WblCpwl_WindowRevDist_SR -> Conti_SWC_FDLib.R_Motor0WblCpwl_WindowRevDist_SR
    connect itsWLWrapper.P_Motor1WblCpwl_AntiPinchData_DID -> Conti_SWC_FDLib.R_Motor1WblCpwl_AntiPinchData_DID
    connect itsWLWrapper.P_Motor1WblCpwl_AntiPinchReserve_DID -> Conti_SWC_FDLib.R_Motor1WblCpwl_AntiPinchReserve_DID
    connect itsWLWrapper.P_Motor1WblCpwl_DID -> Conti_SWC_FDLib.R_Motor1WblCpwl_DID
    connect itsWLWrapper.P_Motor1WblCpwl_DenormPosition_SR -> Conti_SWC_FDLib.R_Motor1WblCpwl_DenormPosition_SR
    connect itsWLWrapper.P_Motor1WblCpwl_DoorStatus -> Conti_SWC_FDLib.R_Motor1WblCpwl_DoorStatus_SR
    connect itsWLWrapper.P_Motor1WblCpwl_ErrorReport -> Conti_SWC_FDLib.R_Motor1WblCpwl_ErrorReport
    connect itsWLWrapper.P_Motor1WblCpwl_GetReservedSelfDiagInfo -> Conti_SWC_FDLib.R_Motor1WblCpwl_GetReservedSelfDiagInfo
    connect itsWLWrapper.P_Motor1WblCpwl_MotorEvent -> Conti_SWC_FDLib.R_Motor1WblCpwl_MotorEvent
    connect itsWLWrapper.P_Motor1WblCpwl_PinchDetected -> Conti_SWC_FDLib.R_Motor1WblCpwl_PinchDetected
    connect itsWLWrapper.P_Motor1WblCpwl_SlpMotorAdaption_DID -> Conti_SWC_FDLib.R_Motor1WblCpwl_SlpMotorAdaption_DID
    connect itsWLWrapper.P_Motor1WblCpwl_TargetSpeed_DID -> Conti_SWC_FDLib.R_Motor1WblCpwl_TargetSpeed_DID
    connect itsWLWrapper.P_Motor1WblCpwl_WindowControl_SR -> Conti_SWC_FDLib.R_Motor1WblCpwl_WindowControl_SR
    connect itsWLWrapper.P_Motor1WblCpwl_WindowRevDist_SR -> Conti_SWC_FDLib.R_Motor1WblCpwl_WindowRevDist_SR
    connect itsWLWrapper.P_MotorAmbientTemperature -> Conti_SWC_FDLib.R_MotorAmbientTemperature
    connect itsWLWrapper.P_SystemTime -> Conti_SWC_FDLib.R_SystemTime
    connect itsWLWrapper.P_VehicleSpeed -> Conti_SWC_FDLib.R_VehicleSpeed
    connect itsWLWrapper.P_WLWrapper_AmbTemp -> Conti_SWC_FDLib.R_WblCpwl_AmbTemp_SR
    connect itsWLWrapper.P_WLWrapper_OSIsr -> Conti_SWC_FDLib.R_IsrLock
    connect itsWLWrapper.P_WLWrapper_OSIsr -> Conti_SWC_FDLib.R_WblCpwl_OS
    connect itsWLWrapper.P_WLWrapper_SystemTime -> Conti_SWC_FDLib.R_WblCpwl_SystemTime_SR
    connect itsWLWrapper.P_WLWrapper_VehSpeed -> Conti_SWC_FDLib.R_WblCpwl_VehSpeed
    connect itsWLWrapper.P_WblCpwl_RoofStatus_SR -> Conti_SWC_FDLib.R_WblCpwl_RoofStatus_SR
    connect itsWLWrapper.P_WblCpwl_ShuntTemperature -> Conti_SWC_FDLib.R_WblCpwl_ShuntTemperature
    connect itsWLWrapper.P_WblCpwl_SupplyVoltageState_SR -> Conti_SWC_FDLib.R_WblCpwl_SupplyVoltageState_SR
